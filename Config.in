## Config.in
```kconfig
# rt-labs
source "$BR2_EXTERNAL_RTLABS_PATH/package/osal/Config.in"
source "$BR2_EXTERNAL_RTLABS_PATH/package/c-open/Config.in"
source "$BR2_EXTERNAL_RTLABS_PATH/package/p-net/Config.in"

# OpenEtherCATSociety
source "$BR2_EXTERNAL_RTLABS_PATH/package/soem/Config.in"
source "$BR2_EXTERNAL_RTLABS_PATH/package/soes/Config.in"

# 3rd party
source "$BR2_EXTERNAL_RTLABS_PATH/package/opener/Config.in"
```

## package/c-open/Config.in
```kconfig
config BR2_PACKAGE_C_OPEN
	bool "c-open"
	depends on BR2_PACKAGE_OSAL
	help
          The rt-labs CANopen stack c-open is used for both master and
          slaves. The stack implements most of CiA 301 and 305
          (LSS). The stack is written to an OS abstraction layer and
          can also be used in a bare metal application. Using the
          abstraction layer, the stack can run on Linux, Windows or on
          an RTOS.

          A simple slave is included to serve as an example of how to
          use the stack. The slave can also be used to run the CiA
          Conformance Test Tool.

          Also included is a simple master example that lists all
          slaves on the bus and a comprehensive set of unit-tests.

          https://github.com/rtlabs-com/c-open

comment "c-open needs the osal package"
	depends on !BR2_PACKAGE_OSAL
```

## package/m-bus/Config.in
```kconfig
config BR2_PACKAGE_M_BUS
	bool "m-bus"
	depends on BR2_PACKAGE_OSAL
	help
          Modbus TCP/RTU stack

          https://github.com/rtlabs-com/m-bus

comment "m-bus needs the osal package"
	depends on !BR2_PACKAGE_OSAL
```

## package/opener/Config.in
```kconfig
config BR2_PACKAGE_OPENER
        bool "OpENer"
        depends on BR2_TOOLCHAIN_HAS_THREADS
        select BR2_PACKAGE_LIBCAP
        help

          OpENer is an EtherNet/IP™ stack for I/O adapter devices;
          supports multiple I/O and explicit connections; includes
          objects and services to make EtherNet/IP™- compliant
          products defined in THE ETHERNET/IP SPECIFICATION and
          published by ODVA (http://www.odva.org).

          https://github.com/EIPStackGroup/OpENer

comment "OpENer needs a toolchain w/ threads"
        depends on !BR2_TOOLCHAIN_HAS_THREADS
```

## package/osal/Config.in
```kconfig
config BR2_PACKAGE_OSAL
	bool "osal"
	depends on BR2_TOOLCHAIN_HAS_THREADS
	help
          This package contains an OS abstraction layer. The goal of
          the abstraction layer is to simplify writing software that
          runs on many platforms. This abstraction layer is mainly
          focused on threading functionality.

          https://github.com/rtlabs-com/osal

if BR2_PACKAGE_OSAL

config BR2_PACKAGE_OSAL_USE_SCHED_FIFO
	bool "Use realtime priority threads"
	default y
	help
	  Attempt to use SCHED_FIFO realtime scheduling. Extra
	  privileges may be required to run the resulting
	  binaries.

endif # BR2_PACKAGE_OSAL

comment "osal needs a toolchain w/ threads"
	depends on !BR2_TOOLCHAIN_HAS_THREADS
```

## package/p-net/Config.in
```kconfig
config BR2_PACKAGE_P_NET
	bool "p-net"
	depends on BR2_PACKAGE_OSAL
	help
          The rt-labs PROFINET stack p-net is used for PROFINET device
          implementations. It is easy to use and provides a small
          footprint. It is especially well suited for embedded systems
          where resources are limited and efficiency is crucial.

          It is written in C and can be run on bare-metal hardware, an
          RTOS such as rt-kernel, or on Linux or Windows. The main
          requirement is that the platform can send and receive RAW
          Ethernet Layer 2 frames. The p-net stack is supplied with
          full sources including a porting layer.

          https://github.com/rtlabs-com/p-net

comment "p-net needs the osal package"
	depends on !BR2_PACKAGE_OSAL
```

## package/soem/Config.in
```kconfig
config BR2_PACKAGE_SOEM
	bool "soem"
	depends on BR2_TOOLCHAIN_HAS_THREADS
	help
          SOEM is an EtherCAT master library written in c. Its purpose
          is to learn and to use. All users are invited to study the
          source to get an understanding how an EtherCAT master
          functions and how it interacts with EtherCAT slaves.

          https://github.com/OpenEtherCATsociety/SOEM

comment "soem needs a toolchain w/ threads"
	depends on !BR2_TOOLCHAIN_HAS_THREADS
```

## package/soes/Config.in
```kconfig
config BR2_PACKAGE_SOES
	bool "soes"
        depends on BR2_LINUX_KERNEL
	help
          SOES is an EtherCAT slave stack written in c. Its purpose is
          to learn and to use. All users are invited to study the
          source to get an understanding how an EtherCAT slave
          functions.

          https://github.com/OpenEtherCATsociety/SOES

if BR2_PACKAGE_SOES

config BR2_PACKAGE_SOES_RPI_ETHERBERRY_DEMO
	bool "Build RPI demo variant"
	default n
	help
		Builds the IO demo variant for Raspberry pi with EtherBerry
		Ethercat hat.

endif # BR2_PACKAGE_SOES

comment "SOES needs a Linux kernel to be built"
        depends on !BR2_LINUX_KERNEL
```
